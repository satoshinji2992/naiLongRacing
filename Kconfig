## Kconfig
```kconfig
#
# For a description of the syntax of this configuration file,
# see the file kconfig-language.txt in the NuttX tools repository.
#

menuconfig EXAMPLES_RACING
	tristate "Racing Game Demo"
	default n
	---help---
		Enable build the Racing Game Demo programs


if EXAMPLES_RACING

config EXAMPLES_RACING_PRIORITY
	int "racing task priority"
	default 100

config EXAMPLES_RACING_STACKSIZE
	int "racing stack size"
	default 327680

config EXAMPLES_RACING_FB_DEVPATH
	string "Framebuffer device path"
	default "/dev/fb0"
	---help---
		The framebuffer device the renderer writes to. Default: "/dev/fb0".

config EXAMPLES_RACING_INPUT_DEVPATH
	string "Touchscreen device path"
	default "/dev/input0"
	depends on INPUT_TOUCHSCREEN
	---help---
		The path to the touchscreen device. Default: "/dev/input0"

config EXAMPLES_RACING_BUTTON1_DEVPATH
	string "Primary GPIO button device path"
	default "/dev/gpio1"
	---help---
		Primary physical button. A rising edge starts/resumes the game,
		pauses while playing, and restarts after winning.

config EXAMPLES_RACING_BUTTON2_DEVPATH
	string "Secondary GPIO button device path"
	default "/dev/gpio3"
	---help---
		Optional secondary physical button. If present, it maps to boost.

config EXAMPLES_RACING_BUTTON3_DEVPATH
	string "Third GPIO button device path"
	default "/dev/gpio4"
	---help---
		Optional third physical button. If present, it maps to fly.

config EXAMPLES_RACING_JY60_DEVPATH
	string "JY60 UART device path"
	default "/dev/uart1"
	---help---
		Serial device for the JY60 gyroscope. The default device path is
		/dev/uart1. Confirm the actual UART1 pins from the board
		pinmux/schematic before wiring.

config EXAMPLES_RACING_JY60_BAUD
	int "JY60 UART baud rate"
	default 9600
	---help---
		Default JY60 serial baud rate. The parser expects the common
		WitMotion/JY60 0x55 0x51/0x52/0x53 binary frames.

config EXAMPLES_RACING_DATA_ROOT
	string "Racing Data Root"
	default "/data"

config EXAMPLES_RACING_VOICE
	bool "Enable XiaoZhi voice control"
	default n
	depends on NET && NET_UDP
	---help---
		Receive XiaoZhi/control_center UI IPC JSON on localhost and map
		recognized text to Racing commands. This reuses the same UDP IPC
		ports as the lvgldemo XiaoZhi UI bridge.

config EXAMPLES_RACING_VOICE_LOCAL_PORT
	int "Racing voice local UI IPC port"
	default 5679
	depends on EXAMPLES_RACING_VOICE
	---help---
		Local UDP port receiving UI JSON from control_center. lvgldemo uses
		UI_PORT_DOWN=5679.

config EXAMPLES_RACING_VOICE_REMOTE_PORT
	int "Racing voice control_center UI IPC port"
	default 5678
	depends on EXAMPLES_RACING_VOICE
	---help---
		control_center UI port used for sending commands back. lvgldemo uses
		UI_PORT_UP=5678.

config EXAMPLES_RACING_VOICE_START_SCRIPT
	string "Racing XiaoZhi startup script"
	default ""
	depends on EXAMPLES_RACING_VOICE && SYSTEM_SYSTEM
	---help---
		Optional script launched from the Racing Network menu. Leave this
		empty when Racing itself is started by /data/racing_xiaozhi.sh,
		otherwise control_center may be started twice and UDP bind will fail.

endif
```
